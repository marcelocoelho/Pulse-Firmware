# CY8C5568AXI_060 register map
File version: 0.1
CY8C55
Registers are 8-bit, read-write, no defined reset value unless marked. A register's access mark holds for its fields unless they carry their own. Offsets are from the block's base; lines under a group give offsets from that group; [hi:lo] are bit positions; {n}, {i} and the like mark numbered series; 'fields as' and 'values as' point back to an identical list; <NAME> marks a mode.

## Memory map
0x00000000 USBUART_1 — USBFS

## USBUART_1 — USBFS
Base 0x00000000
0x40006000 USBUART_1_EP0_DR0_REG — bmRequestType
0x40006001 USBUART_1_EP0_DR1_REG — bRequest
0x40006002 USBUART_1_EP0_DR2_REG — wValueLo
0x40006003 USBUART_1_EP0_DR3_REG — wValueHi
0x40006004 USBUART_1_EP0_DR4_REG — wIndexLo
0x40006005 USBUART_1_EP0_DR5_REG — wIndexHi
0x40006006 USBUART_1_EP0_DR6_REG — lengthLo
0x40006007 USBUART_1_EP0_DR7_REG — lengthHi
0x40006008 USBUART_1_CR0_REG — USB Control Register 0
0x40006009 USBUART_1_CR1_REG — USB Control Register 1
{0x40005FFE+0x10*i} USBUART_1_SIE_EP{i}_CR0_REG (i=1..8) — The Endpoint{i} Control Register
0x40006010 USBUART_1_USBIO_CR0_REG — USBIO Control Register 0
0x40006011 USBUART_1_USBIO_CR2_REG — USBIO Control Register 2
0x40006012 USBUART_1_USBIO_CR1_REG — USBIO Control Register 1
